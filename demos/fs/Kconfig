## kernel/Kconfig
```kconfig
menu "Kernel"

menuconfig LOSCFG_KERNEL_SMP
    bool "Enable Kernel SMP"
    default n
    depends on LOSCFG_ARCH_ARM_AARCH32 || LOSCFG_ARCH_ARM_AARCH64
    select LOSCFG_BASE_CORE_SWTMR
    help
      This option will enable smp support of LiteOS.

if LOSCFG_KERNEL_SMP

config LOSCFG_KERNEL_SMP_CORE_NUM
    int "Muti-processing Core Numbers"
    default 2
    help
      This represents the number of muti-processing cores.

config LOSCFG_KERNEL_SMP_LOCKDEP
    bool "Enable Spinlock Lockdep Check"
    default n
    help
      This option will enable spinlock lockdep check.

config LOSCFG_KERNEL_SMP_TASK_SYNC
    bool "Enable Synchronized Task Operations"
    default n
    help
      This option will enable task synchronized operate task across cores.

config LOSCFG_KERNEL_SMP_CALL
    bool "Enable Function call cross Multi-core"
    default n
    help
      This option will enable function call on multi-core.

endif # LOSCFG_KERNEL_SMP

menu "Basic Config"

choice
    prompt "Scheduler"
    default LOSCFG_SCHED_SQ
    help
      The scheduler used to dispatch tasks.

config LOSCFG_SCHED_SQ
    bool "Single Ready Queue"
    help
      The scheduler uses a single ready queue.

#config LOSCFG_SCHED_MQ
#    bool "Mutiple Ready Queue"
#    help
#      The scheduler uses multiple ready queues.
endchoice

menu "Task"

config LOSCFG_BASE_CORE_TIMESLICE
    bool "Enable Timeslice"
    default y

config LOSCFG_BASE_CORE_TIMESLICE_TIMEOUT
    int "Timeslice Value(ticks)"
    default 2
    depends on LOSCFG_BASE_CORE_TIMESLICE
    help
      This represents task slice's value(ticks).

config LOSCFG_OBSOLETE_API
    bool "Enable Obsolete Api"
    default n
    help
      Task processing function parameters use the old way.

config LOSCFG_LAZY_STACK
    bool "Enable Lazy Stack Function"
    default n
    help
      Task lazy stack function.

config LOSCFG_BASE_CORE_TSK_MONITOR
    bool "Enable Task Monitor Function"
    default y
    help
      This represents to be support to monitor task stack and switch info.

config LOSCFG_TASK_STATIC_ALLOCATION
    bool "Enable Task Create Static Allocation"
    default n
    help
        This represents to support task create static allocation.

config LOSCFG_BASE_CORE_TSK_LIMIT
    int "Max Task Number"
    default 64
    help
      This represents the max number of task.

config LOSCFG_TASK_MIN_STACK_SIZE
    int "Task Min Stack Size"
    default 2048
    help
      This represents the task min stack size.

config LOSCFG_BASE_CORE_TSK_DEFAULT_STACK_SIZE
    int "Task Defalut Stack Size"
    default 24576
    help
      This represents the task default stack size.

config LOSCFG_BASE_CORE_TSK_SWTMR_STACK_SIZE
    int "Swtmr Task Stack Size"
    default 24576
    help
      This represents the swtmr task stack size.

config LOSCFG_BASE_CORE_TSK_IDLE_STACK_SIZE
    int "Idle Task Stack Size"
    default 2048
    help
      This represents the idle task stack size.

config LOSCFG_BASE_CORE_TSK_DEFAULT_PRIO
    int "Task Default Priority"
    default 10
    help
      This represents the task default priority and the max priority is 32.

config LOSCFG_BASE_CORE_TICK_PER_SECOND
    int "Tick Value Per Second"
    default 100
    help
      This represents the tick value per second.

endmenu

choice
    prompt "Sortlink Option"
    default LOSCFG_BASE_CORE_USE_MULTI_LIST
    help
      The scheduler used to dispatch tasks.

config LOSCFG_BASE_CORE_USE_MULTI_LIST
    bool "Use Multi List"
    help
      The scheduler uses a single ready queue.

config LOSCFG_BASE_CORE_USE_SINGLE_LIST
    bool "Use Single List"
    help
      Use Single List for Task & Swtmr.
endchoice

endmenu

source "kernel/base/mem/Kconfig"

menu "Hardware Interrupt"

config LOSCFG_ARCH_INTERRUPT_PREEMPTION
    bool "Enable Interrupt Preemption"
    depends on (LOSCFG_ARCH_ARM_AARCH64 || LOSCFG_ARCH_RISCV)
    default n

config LOSCFG_IRQ_USE_STANDALONE_STACK
    bool "Use standalone interrupt stack"
    default y
    depends on LOSCFG_ARCH_ARM_AARCH64 || LOSCFG_ARCH_ARM_AARCH32
    help
      This option will support using standalone interrupt stack.

config LOSCFG_NO_SHARED_IRQ
    bool "Enable interrupt no share"
    default n

config LOSCFG_PLATFORM_HWI_LIMIT
    int "Max Hardware Interrupts"
    default 96
    help
      This represents the maximum number of hardware interrupts, including Tick interrupt.

config LOSCFG_HWI_PRIO_LIMIT
    int "Interrupt priority range"
    default 32
    help
      This parameter indicates the total number of interrupt priorities.

endmenu

menu "Exception Management"
config LOSCFG_ARCH_EXC_SIMPLE_INFO
    bool "Enable Exception Simple Info"
    default n
    help
      This option is used to reduce exc output info.
endmenu

menuconfig LOSCFG_BASE_CORE_SWTMR
    bool "Enable Software Timer"
    default y
    select LOSCFG_BASE_IPC_QUEUE

if LOSCFG_BASE_CORE_SWTMR

config LOSCFG_BASE_CORE_SWTMR_LIMIT
    int "Max Swmtmr Number"
    default 1024
    help
      This represents the maximum number of soft-timers.

config LOSCFG_BASE_CORE_SWTMR_IN_ISR
    bool "Software Timer callback in interrupt"
    default n

endif # LOSCFG_BASE_CORE_SWTMR

menuconfig LOSCFG_BASE_IPC_QUEUE
    bool "Enable Queue"
    default y

if LOSCFG_BASE_IPC_QUEUE

config LOSCFG_QUEUE_STATIC_ALLOCATION
    bool "Enable Queue Static Allocation"
    default n
    help
      This option will support static alloction interface for users to create a queue.

config LOSCFG_BASE_IPC_QUEUE_LIMIT
    int "Max Queue Number"
    default 1024
    help
      This represents the maximum number of queues.

endif # LOSCFG_BASE_IPC_QUEUE

menuconfig LOSCFG_BASE_IPC_EVENT
    bool "Enable Event"
    default y

if LOSCFG_BASE_IPC_EVENT

config LOSCFG_BASE_IPC_EVENT_LIMIT
    int "Max Event Number"
    default 1024
    help
      This represents the maximum number of events.

endif # LOSCFG_BASE_IPC_EVENT

menuconfig LOSCFG_BASE_IPC_MUX
    bool "Enable Mutex"
    default y

if LOSCFG_BASE_IPC_MUX

choice
    prompt "Mutex wait mode"
    default LOSCFG_MUTEX_WAITMODE_PRIO
    help
      Mutex wait mode choice.

config LOSCFG_MUTEX_WAITMODE_PRIO
    bool "Mutex wait with priority mode"
    help
      If multiple tasks are blocking and wait for a mutex, they are queued in priority mode.

config LOSCFG_MUTEX_WAITMODE_FIFO
    bool "Mutex wait with fifo mode"
    help
      If multiple tasks are blocking and wait for a mutex, they are queued in FIFO mode.
endchoice

config LOSCFG_BASE_IPC_MUX_LIMIT
    int "Max Mutex Number"
    default 1024
    help
      This represents the maximum number of mutexes.

endif # LOSCFG_BASE_IPC_MUX

menuconfig LOSCFG_BASE_IPC_SEM
    bool "Enable Sem"
    default y

if LOSCFG_BASE_IPC_SEM

config LOSCFG_BASE_IPC_SEM_LIMIT
    int "Max Semphore Number"
    default 1024
    help
      This represents the maximum number of semaphores.

endif # LOSCFG_BASE_IPC_SEM

config LOSCFG_KERNEL_NX
    bool "Enable Data Sec NX Feature"
    default n
    help
      If you need enable data section No-eXecute.

config LOSCFG_KERNEL_RINGBUF
    bool "Enable Ringbuf"
    default n
    help
      If you wish to build LiteOS with support for ringbuf.

menuconfig LOSCFG_KERNEL_CONSOLE
    bool "Enable Console"
    default y
    depends on LOSCFG_FS_VFS
    select LOSCFG_KERNEL_RINGBUF
    help
      Answer Y to enable LiteOS support for console.

if LOSCFG_KERNEL_CONSOLE

config LOSCFG_CONSOLE_RINGBUFF_SIZE
    int "size of console ringbuff"
    default 4096
    help
      This option will change console ringbuff size.

endif # LOSCFG_KERNEL_CONSOLE

config LOSCFG_KERNEL_EXTKERNEL
    bool "Enable Extend Kernel"
    default y
    help
      This option will enable extend Kernel of LiteOS.  Extend kernel include
      cppsupport, cpup, dynload, runstop and scatter. You can select one or some
      of them.

config LOSCFG_KERNEL_CPPSUPPORT
    bool "C++ Support"
    default y
    depends on LOSCFG_KERNEL_EXTKERNEL
    help
      If you wish to build LiteOS with support for C++.

config LOSCFG_KERNEL_CPUP
    bool "Enable Cpup"
    default y
    select LOSCFG_BASE_CORE_SWTMR
    depends on LOSCFG_KERNEL_EXTKERNEL
    help
      If you wish to build LiteOS with support for cpup.

config LOSCFG_CPUP_INCLUDE_IRQ
    bool "Enable Cpup include irq"
    default y
    depends on LOSCFG_KERNEL_CPUP
    help
      If you wish to include irq usage for cpup.

config LOSCFG_KERNEL_DYNLOAD
    bool "Enable Dynamic Load Feature"
    default y
    depends on LOSCFG_KERNEL_EXTKERNEL
    select LOSCFG_BASE_IPC_MUX
    help
      If you wish to build LiteOS with support for dynamic load.
      If enbaled Nx then you can only load 4K aligned so files, otherwise a page fault may occur.

config LOSCFG_KERNLE_DYN_HEAPSIZE
    int "Dynamic load heap size in M"
    default 2
    depends on LOSCFG_KERNEL_NX && LOSCFG_KERNEL_DYNLOAD
    help
      This represents the heap size of dynamic load in M.

menu "Dynamic Load Options"
    depends on LOSCFG_KERNEL_DYNLOAD

config LOSCFG_KERNEL_DYNLOAD_DYN
    bool "Enable Dynamic Load Shared object file"
    default y

menu "Dynamic Load Shared object file Options"
    depends on LOSCFG_KERNEL_DYNLOAD_DYN

config LOSCFG_DYNLOAD_DYN_FROM_FS
    bool "Enable Dynamic Load Shared object file from FS"
    default y
    depends on LOSCFG_FS_VFS

config LOSCFG_DYNLOAD_DYN_FROM_MEM
    bool "Enable Dynamic Load Shared object file from memory"
    default y

endmenu

config LOSCFG_KERNEL_DYNLOAD_REL
    bool "Enable Dynamic Load Relocatable file"
    default y

menu "Dynamic Load Relocatable file Options"
    depends on LOSCFG_KERNEL_DYNLOAD_REL

config LOSCFG_DYNLOAD_REL_FROM_FS
    bool "Enable Dynamic Load Relocatable file from FS"
    default y
    depends on LOSCFG_FS_VFS

endmenu

endmenu

config LOSCFG_KERNEL_LOWPOWER
    bool "Enable Low Power Management Framework"
    default y
    depends on LOSCFG_KERNEL_EXTKERNEL
    help
      If you wish to build LiteOS with support for low power management framework.

menu "Low Power Management Configure"
    depends on LOSCFG_KERNEL_LOWPOWER

config LOSCFG_KERNEL_TICKLESS
    bool "Enable Tickless Feature"
    default y
    depends on LOSCFG_KERNEL_LOWPOWER
    help
      If you wish to build LiteOS with support for tickless.

config LOSCFG_KERNEL_POWER_MGR
    bool "Enable Default Implementation of Low Power Management Framework"
    default n
    depends on LOSCFG_KERNEL_LOWPOWER
    help
      If you wish to build LiteOS with support for tickless.

config LOSCFG_KERNEL_DEEPSLEEP
    bool "Enable Deep Sleep Feature"
    default n
    depends on LOSCFG_KERNEL_POWER_MGR
    help
      If you wish to build LiteOS with support for deep sleep.

config LOSCFG_KERNEL_RUNSTOP
    bool "Enable Run stop Feature"
    default n
    depends on LOSCFG_KERNEL_POWER_MGR && (LOSCFG_DRIVERS_MTD_NAND || LOSCFG_DRIVERS_MTD_SPI_NOR) && \
               LOSCFG_KERNEL_MEM_BESTFIT
    help
      If you wish to build LiteOS with support for run-stop.

endmenu

config LOSCFG_KERNEL_SCATTER
    bool "Enable Scatter Feature"
    default y
    depends on LOSCFG_KERNEL_EXTKERNEL && (LOSCFG_DRIVERS_MTD_NAND || LOSCFG_DRIVERS_MTD_SPI_NOR)
    help
      If you wish to build LiteOS with support for scatter.

config LOSCFG_KERNEL_PERF
   bool "Enable Perf Feature"
   default n
   depends on LOSCFG_KERNEL_EXTKERNEL
   select LOSCFG_KERNEL_RINGBUF
   select LOSCFG_KERNEL_SMP_CALL if LOSCFG_KERNEL_SMP
   help
     If you wish to build LiteOS with support for perf.

choice
   prompt "Time-consuming Calc Methods"
   depends on LOSCFG_KERNEL_PERF

config LOSCFG_PERF_CALC_TIME_BY_TICK
   bool "By Tick"

config LOSCFG_PERF_CALC_TIME_BY_CYCLE
   bool "By Cpu Cycle"

endchoice

config LOSCFG_PERF_HW_PMU
   bool "Enable Hardware Pmu Events for Sampling"
   default n
   depends on LOSCFG_KERNEL_PERF

config LOSCFG_PERF_TIMED_PMU
   bool "Enable Hrtimer Period Events for Sampling"
   default n
   depends on LOSCFG_KERNEL_PERF && LOSCFG_COMPAT_LINUX

config LOSCFG_PERF_SW_PMU
   bool "Enable Software Events for Sampling"
   default y
   depends on LOSCFG_KERNEL_PERF

config LOSCFG_KERNEL_TRACE
    bool "Enable Trace Feature"
    default n
    depends on LOSCFG_KERNEL_EXTKERNEL

choice
    prompt "Trace work mode"
    default LOSCFG_RECORDER_MODE_OFFLINE
    depends on LOSCFG_KERNEL_TRACE

config LOSCFG_RECORDER_MODE_ONLINE
    bool "Online mode"
    select LOSCFG_TRACE_CLIENT_INTERACT

config LOSCFG_RECORDER_MODE_OFFLINE
    bool "Offline mode"

endchoice

config LOSCFG_TRACE_CLIENT_INTERACT
    bool "Enable Trace Client Visualization and Control"
    default n
    depends on LOSCFG_KERNEL_TRACE

choice
    prompt "Trace Pipeline for Data Transmission"
    depends on LOSCFG_TRACE_CLIENT_INTERACT

config LOSCFG_TRACE_PIPELINE_SERIAL
    bool "Via Serial"

endchoice

choice
    prompt "Trace Control"
    default LOSCFG_TRACE_CONTROL_VIA_SHELL
    depends on LOSCFG_TRACE_CLIENT_INTERACT
    help
      If you wish to control Trace's start/stop etc.,dynamically by Trace Client.

config LOSCFG_TRACE_CONTROL_VIA_SHELL
    bool "Via Shell"
    select LOSCFG_SHELL

config LOSCFG_TRACE_CONTROL_AGENT
    bool "Via Trace Agent Task"

config LOSCFG_TRACE_NO_CONTROL
    bool "No Control"

endchoice

endmenu
```

## kernel/base/mem/Kconfig
```kconfig
menu "Memory Management"

choice
    prompt "Dynamic Memory Management Algorithm"
    default LOSCFG_KERNEL_MEM_BESTFIT

config LOSCFG_KERNEL_MEM_BESTFIT
    bool "bestfit"
    help
      This option will change mem type as bestfit

config LOSCFG_KERNEL_MEM_BESTFIT_LITTLE
    bool "bestfit_little"
    help
      This option will change mem type as bestfit little
endchoice

config LOSCFG_KERNEL_MEM_SLAB_EXTENTION
    bool "Enable Mem SLAB Extention"
    default n

config LOSCFG_KERNEL_MEM_SLAB_AUTO_EXPANSION_MODE
    bool "Enable Mem SLAB Auto Expansion Mode"
    default n
    depends on LOSCFG_KERNEL_MEM_SLAB_EXTENTION

config LOSCFG_MEM_TASK_STAT
    bool "Enable Memory Task Usage Statistics"
    default y
    depends on (LOSCFG_KERNEL_MEM_BESTFIT || LOSCFG_KERNEL_MEM_BESTFIT_LITTLE)
    help
      Answer Y to enable LiteOS support memory task statistics

config LOSCFG_KERNEL_MEMBOX
    bool "Membox Management"
    default y

choice
    prompt "Membox Management Algorithm"
    default LOSCFG_KERNEL_MEMBOX_STATIC
    depends on LOSCFG_KERNEL_MEMBOX

config LOSCFG_KERNEL_MEMBOX_STATIC
    bool "static memory"
    help
      This option will change membox implemented with input memory

config LOSCFG_KERNEL_MEMBOX_DYNAMIC
    bool "dynamic memory"
    help
      This option will change membox implemented with dynamic allocated memory

endchoice

endmenu
```

## kernel/extended/lms/Kconfig
```kconfig
config LOSCFG_KERNEL_LMS
    bool "Enable Lite Memory Sanitizer"
    default n
    depends on LOSCFG_KERNEL_MEM_BESTFIT &&  !LOSCFG_KERNEL_MEM_SLAB_EXTENTION
    help
      Select y to build LiteOS with memory sanitizer.
```
