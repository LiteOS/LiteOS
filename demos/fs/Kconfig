## lib/Kconfig
```kconfig
menu "Lib"
    depends on !LOSCFG_ARCH_XTENSA

config LOSCFG_LIB_LIBC
    bool "Enable Libc"
    default y
    help
      Answer Y to enable LiteOS support libc.

config  LOSCFG_COMPAT_POSIX
    bool "Enable Posix"
    default y
    depends on LOSCFG_LIB_LIBC
    select LOSCFG_BASE_IPC_MUX
    select LOSCFG_BASE_IPC_SEM
    select LOSCFG_BASE_CORE_SWTMR
    help
      Answer Y to enable LiteOS support posix interface.

config LOSCFG_LIB_LIBM
    bool "Enable Math"
    default y
    depends on LOSCFG_LIB_LIBC
    help
      Answer Y to enable LiteOS support math function.

config LOSCFG_LIB_STDIO
    bool "Enable Stdio"
    default y
    depends on LOSCFG_LIB_LIBC
    select LOSCFG_COMPAT_POSIX
    select LOSCFG_LIB_LIBM
    help
      Answer Y to enable LiteOS support I/O function.

config LOSCFG_SUPPORT_LONG_DOUBLE
    bool "Support Long Double Float Type"
    default y
    depends on LOSCFG_LIB_STDIO || LOSCFG_LIB_LIBM || LOSCFG_COMPAT_POSIX
    help
      Answer Y to enable LiteOS support long double float type.

config LOSCFG_LIB_ZLIB
    bool "Enable Zlib"
    default y
    select LOSCFG_LIB_LIBC
    select LOSCFG_LIB_LIBM
    help
      Answer Y to enable LiteOS support compress file library.
endmenu
```

## shell/Kconfig
```kconfig
config LOSCFG_SHELL
    bool "Enable Shell"
    default n
    depends on LOSCFG_DEBUG_VERSION
    help
      Answer Y to enable LiteOS support shell cmd.

menu "Functionality of Shell"
    depends on LOSCFG_SHELL

choice
    prompt "Select shell functionality"
    default LOSCFG_SHELL_FULL_CAP
    help
      Select functionality for shell
       Functionality of shell is used at the real board
      Mini shell is used at software simulation like qemu

config LOSCFG_SHELL_FULL_CAP
    bool "Enable full functionality of shell"
    select LOSCFG_COMPAT_POSIX
    help
      Functionality of shell is used at the real board

endchoice

choice
    prompt "Select Shell Input"
    default LOSCFG_SHELL_UART
    depends on LOSCFG_SHELL_FULL_CAP
    help
      Select shell input, when the input source is chosen, the shell will read the
      terminal input from the source.

config LOSCFG_SHELL_UART
    bool "Uart"
    select LOSCFG_COMPAT_LINUX
    help
      The shell will directly interact with the uart drivers, and only one input
      source is supported.

endchoice

config LOSCFG_SHELL_LK
    bool "Enable Shell lk"
    default y
    depends on LOSCFG_DEBUG_VERSION && LOSCFG_SHELL && LOSCFG_SHELL_FULL_CAP
    help
      Answer Y to enable LiteOS support shell lk.

config LOSCFG_SHELL_DMESG
    bool "Enable Shell dmesg"
    default n
    depends on LOSCFG_DEBUG_VERSION && LOSCFG_SHELL && LOSCFG_SHELL_FULL_CAP
    help
      Answer Y to enable LiteOS support shell dmesg.

config LOSCFG_SHELL_EXCINFO_DUMP
    bool "Enable Shell excInfo"
    default n
    depends on LOSCFG_DEBUG_VERSION && LOSCFG_SHELL && LOSCFG_SHELL_FULL_CAP
    help
      Answer Y to enable LiteOS support shell excInfo.

endmenu
```

## targets/GD32VF103V_EVAL/Demos/Kconfig
```kconfig
choice Demo
	optional
	prompt "User Defined Demo"
	config Demo_None
		bool "none"
	config Demo_Helloworld
		bool "Hello World"
		select SHELL_ENABLE
	config Demo_Develop
		bool "OC develop"
		select OC_MQTT
                select CJSON
		select EC20
	config Demo_Oceanlink
		bool "OC Oceanlink"
		select OC_MQTT
                select CJSON
		select EC20
endchoice

config USER_DEMO
	string
	default "hello_world_demo" if Demo_Helloworld
	default "oc_develop_template" if Demo_Develop
	default "oc_oceanlink_template" if Demo_Oceanlink
	default "none"
```

## targets/Kconfig
```kconfig
config LOSCFG_PLATFORM
    string
    default "Cloud_STM32F429IGTx_FIRE"  if LOSCFG_PLATFORM_STM32F429IGTX
    default "STM32F769IDISCOVERY"       if LOSCFG_PLATFORM_STM32F769IDISCOVERY
    default "STM32L431_BearPi"          if LOSCFG_PLATFORM_STM32L431_BearPi
    default "STM32F103_FIRE_Arbitrary"  if LOSCFG_PLATFORM_STM32F103_FIRE_ARBITRARY
    default "STM32F407_ATK_Explorer"    if LOSCFG_PLATFORM_STM32F407_ATK_EXPLORER
    default "STM32F072_Nucleo"          if LOSCFG_PLATFORM_STM32F072_Nucleo
    default "realview-pbx-a9"           if LOSCFG_PLATFORM_PBX_A9
    default "qemu-virt-a53"             if LOSCFG_PLATFORM_QEMU_VIRT_A53

choice
    prompt "Target"
    default LOSCFG_PLATFORM_STM32F429IGTX
    help
      support several boards:
      Cloud_STM32F429IGTx_FIRE
      STM32F769IDISCOVERY
      STM32L431_BearPi
      STM32F103_FIRE_Arbitrary
      STM32F407_ATK_Explorer
      STM32F072_Nucleo
      realview-pbx-a9
      qemu-virt-a53

config LOSCFG_PLATFORM_STM32F429IGTX
    bool "Cloud_STM32F429IGTx_FIRE"
    select LOSCFG_USING_BOARD_LD
    select LOSCFG_ARCH_CORTEX_M4

config LOSCFG_PLATFORM_STM32F769IDISCOVERY
    bool "STM32F769IDISCOVERY"
    select LOSCFG_USING_BOARD_LD
    select LOSCFG_ARCH_CORTEX_M7

config LOSCFG_PLATFORM_STM32L431_BearPi
    bool "STM32L431_BearPi"
    select LOSCFG_USING_BOARD_LD
    select LOSCFG_ARCH_CORTEX_M4

config LOSCFG_PLATFORM_STM32F103_FIRE_ARBITRARY
    bool "STM32F103_FIRE_Arbitrary"
    select LOSCFG_USING_BOARD_LD
    select LOSCFG_ARCH_CORTEX_M3

config LOSCFG_PLATFORM_STM32F407_ATK_EXPLORER
    bool "STM32F407_ATK_Explorer"
    select LOSCFG_USING_BOARD_LD
    select LOSCFG_ARCH_CORTEX_M4

config LOSCFG_PLATFORM_STM32F072_Nucleo
    bool "STM32F072_Nucleo"
    select LOSCFG_USING_BOARD_LD
    select LOSCFG_ARCH_CORTEX_M0

config LOSCFG_PLATFORM_PBX_A9
    bool "realview-pbx-a9"
    select LOSCFG_USING_BOARD_LD
    select LOSCFG_ARCH_CORTEX_A9

config LOSCFG_PLATFORM_QEMU_VIRT_A53
    bool "qemu-virt-a53"
    select LOSCFG_USING_BOARD_LD
    select LOSCFG_ARCH_CORTEX_A53
    select LOSCFG_ARCH_ARM_AARCH64

endchoice

config LOSCFG_USING_BOARD_LD
    bool
```

## targets/STM32F429IGTx_FIRE/Demos/Kconfig
```kconfig
choice Demo
	optional
	prompt "User Defined Demo"
	config Demo_None
		bool "none"
	config Demo_Helloworld
		bool "Hello World"
		select SHELL_ENABLE
endchoice

config USER_DEMO
	string
	default "hello_world_demo" if Demo_Helloworld
	default "none"
```

## targets/STM32L431_BearPi/Demos/Kconfig
```kconfig
choice Demo
	optional
	prompt "User Defined Demo"
	config Demo_None
		bool "none"
	config Demo_Helloworld
		bool "Hello World"
		select SHELL_ENABLE
	config Demo_Streetlight
		bool "OC Streetlight"
		select OC_LWM2M
		select SHELL_ENABLE
		select AT_ENABLE
		select BOUDICA150
		select STIMER_ENABLE
	config Demo_OC_Cloud_Map
		bool "OC Cloud Map"
		select OC_LWM2M
		select SHELL_ENABLE
		select AT_ENABLE
		select BOUDICA150
		select STIMER_ENABLE
endchoice

config USER_DEMO
	string
	default "hello_world_demo" if Demo_Helloworld
	default "oc_streetlight_template" if Demo_Streetlight
	default "oc_cloud_map_demo" if Demo_OC_Cloud_Map
	default "none"
```

## targets/bsp/Kconfig
```kconfig
source "targets/Kconfig"

choice
    prompt "IRQCHIP"
    default LOSCFG_PLATFORM_BSP_NVIC
    help
      Interrupt Controller.

config LOSCFG_PLATFORM_BSP_GIC_V2
    bool "GIC Version 2"
    help
      This GIC(General Interrupt Controller) version 2 driver is compatatble with
      GIC version 1 and version 2.

config LOSCFG_PLATFORM_BSP_GIC_V3
    bool "GIC Version 3"
    depends on LOSCFG_ARCH_ARM_V8A || LOSCFG_ARCH_ARM_V8R
    help
      General Interrupt Controller version 3.

config LOSCFG_PLATFORM_BSP_NVIC
    bool "NVIC"
    help
      NVIC(Nested Vectored Interrupt Controller) for Cortex-M.

config LOSCFG_PLATFORM_BSP_XTENSA_XEA3
    bool "XTENSA Xea3"
    help
      General Interrupt Controller xtensa xea3.

config LOSCFG_RISCV_HIMIDEERV200_PLIC
    bool "RISCV PLIC"
    depends on LOSCFG_ARCH_RISCV
    help
      HiMiDeerV200 Riscv Platform Level Interrupt Controller
endchoice
```
