## demos/fs/Kconfig
```kconfig
menu "FileSystem Demo"

config LOSCFG_DEMOS_FS_FAT
    bool "Enable Fat FileSystem Demo"
    default n
    depends on LOSCFG_COMPONENTS_FS_FATFS
    select LOSCFG_DEMOS_FS
    help
      Answer y to enable fat filesystem demo.

choice
    prompt "Choose FatFs Hardware Device"
    default LOSCFG_FATFS_USE_SD_CARD
    depends on LOSCFG_DEMOS_FS_FAT

    config LOSCFG_FATFS_USE_SD_CARD
        bool "Enable Fatfs Use SD Card"

    config LOSCFG_FATFS_USE_SPI_FLASH
        bool "Enable Fatfs Use SPI Flash"
endchoice

config LOSCFG_DEMOS_FS_SPIF
    bool "Enable Spi Flash FileSystem Demo"
    default n
    depends on LOSCFG_COMPONENTS_FS_SPIFFS
    select LOSCFG_DEMOS_FS
    help
      Answer y to enable spi flash filesystem demo.

config LOSCFG_DEMOS_FS_RAM
    bool "Enable Ram FileSystem Demo"
    default n
    depends on LOSCFG_COMPONENTS_FS_RAMFS
    select LOSCFG_DEMOS_FS
    help
      Answer y to enable ram filesystem demo.

config LOSCFG_DEMOS_FS
    bool

endmenu
```

## demos/gui/Kconfig
```kconfig
menu "Graphical User Interface Demo"

comment "only support STM32F769IDISCOVERY"

config LOSCFG_DEMOS_GUI
    bool "Enable Gui Demo"
    default y
    depends on LOSCFG_COMPONENTS_GUI
    select LOSCFG_GUI_ENABLE
    help
      Answer y to enable Graphical User Interface demo.

   config LOSCFG_GUI_ENABLE
   bool

endmenu
```

## demos/ipv6_client/Kconfig
```kconfig
menu "Ipv6 Client Demo"

config LOSCFG_DEMOS_IPV6_CLIENT
    bool "Enable Ipv6 Client Demo"
    default n
    help
      Answer y to enable ipv6 client demo.

choice
    prompt "Enable Tcp Or Udp"
    default LOSCFG_DEMOS_IPV6_TCP_CLIENT
    depends on LOSCFG_DEMOS_IPV6_CLIENT

    config LOSCFG_DEMOS_IPV6_TCP_CLIENT
    bool "Enable Tcp Client"

    config LOSCFG_DEMOS_IPV6_UDP_CLIENT
    bool "Enable Udp Client"

endchoice

endmenu
```

## demos/kernel/Kconfig
```kconfig
menu "Kernel Demo"

config LOSCFG_DEMOS_KERNEL
   bool "Enable Kernel Demo"
   default n
   help
   Answer y to enable kernel demo.

config LOSCFG_DEMOS_KERNEL_SELECT
   depends on LOSCFG_DEMOS_KERNEL
   string
   default "DemoEntry"              if LOSCFG_DEMOS_KERNEL_ENTRY
   default "InspectEntry"           if LOSCFG_DEMOS_KERNEL_INSPECT_ENTRY

choice
   prompt "Kernel Demo Entry"
   depends on LOSCFG_DEMOS_KERNEL
   default LOSCFG_DEMOS_KERNEL_INSPECT_ENTRY
   help
      support entry:
      DemoEntry
      InspectEntry

config LOSCFG_DEMOS_KERNEL_INSPECT_ENTRY
   bool "InspectEntry"

config LOSCFG_DEMOS_KERNEL_ENTRY
   bool "DemoEntry"

config LOS_KERNEL_DEMO_TASK
   bool "Run Kernel Task Demo"
   depends on LOSCFG_DEMOS_KERNEL_ENTRY
   default n
   help
     Answer y to run kernel task demo.

config LOS_KERNEL_DEMO_MEM_DYNAMIC
   bool "Run Kernel Dynamic Mem Demo"
   depends on LOSCFG_DEMOS_KERNEL_ENTRY
   default n
   help
     Answer y to run kernel dynamic mem demo.

config LOS_KERNEL_DEMO_MEM_STATIC
   bool "Run Kernel Static Mem Demo"
   depends on LOSCFG_DEMOS_KERNEL_ENTRY
   default n
   help
     Answer y to run kernel mem_static demo.

config LOS_KERNEL_DEMO_INTERRUPT
   bool "Run Kernel Interrupt Demo"
   depends on LOSCFG_DEMOS_KERNEL_ENTRY
   default n
   help
     Answer y to run kernel interrupt demo.

config LOS_KERNEL_DEMO_QUEUE
   bool "Run Kernel Queue Demo"
   depends on LOSCFG_DEMOS_KERNEL_ENTRY
   default n
   help
     Answer y to run kernel queue demo.

config LOS_KERNEL_DEMO_EVENT
   bool "Run Kernel Event Demo"
   depends on LOSCFG_DEMOS_KERNEL_ENTRY
   default n
   help
     Answer y to run kernel event demo.

config LOS_KERNEL_DEMO_MUTEX
   bool "Run Kernel Mutex Demo"
   depends on LOSCFG_DEMOS_KERNEL_ENTRY
   default n
   help
     Answer y to run kernel mutex demo.

config LOS_KERNEL_DEMO_SEMPHORE
   bool "Run Kernel Semphore Demo"
   depends on LOSCFG_DEMOS_KERNEL_ENTRY
   default n
   help
     Answer y to run kernel semphore demo.

config LOS_KERNEL_DEMO_SYSTICK
   bool "Run Kernel Systick Demo"
   depends on LOSCFG_DEMOS_KERNEL_ENTRY
   default n
   help
     Answer y to run kernel systick demo.

config LOS_KERNEL_DEMO_SWTIMER
   bool "Run Kernel Software Timer Demo"
   depends on LOSCFG_DEMOS_KERNEL_ENTRY
   default n
   help
     Answer y to run kernel software timer demo.

config LOS_KERNEL_DEMO_LIST
   bool "Run Kernel List Demo"
   depends on LOSCFG_DEMOS_KERNEL_ENTRY
   default n
   help
     Answer y to run kernel list demo.

endchoice

endmenu
```

## demos/lms/Kconfig
```kconfig
menu "LMS Demo"

config LOSCFG_DEMOS_LMS
    bool "Enable LMS Demo"
    default n
    depends on LOSCFG_KERNEL_LMS
    help
      Answer y to enable LMS demo

endmenu
```

## demos/nbiot_without_atiny/Kconfig
```kconfig
menu "NB-IoT Demo Without Atiny"

config LOSCFG_DEMOS_NBIOT_WITHOUT_ATINY
    bool "Enable NB-IoT Demo"
    default n
    help
        Answer y to enable nbiot demo without atiny.

config LOSCFG_DEMOS_NBIOT_DTLS
    bool "Enable NB-IoT Demo With Dtls"
    default n
    depends on LOSCFG_DEMOS_NBIOT_WITHOUT_ATINY
    help
        Answer y to enable nbiot demo with dtls.

endmenu
```

## demos/sensorhub/Kconfig
```kconfig
menu "Sensorhub Demo"

comment "only support Cloud_STM32F429IGTx_FIRE"

config LOSCFG_DEMOS_SENSORHUB
    bool "Enable Sensorhub Demo"
    default n
    depends on LOSCFG_COMPONENTS_SENSORHUB
    help
      Answer y to enable sensorhub demo.

endmenu
```

## demos/trace/Kconfig
```kconfig
menu "Trace Demo"

config LOSCFG_DEMOS_TRACE
    bool "Enable Trace Demo"
    default n
    depends on LOSCFG_KERNEL_TRACE
    help
      Answer y to enable trace demo.

endmenu
```
