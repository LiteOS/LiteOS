## Kconfig
```kconfig
mainmenu "Huawei IoT Stack Configuration"
	
	menu "OC Integration Demo"
		choice OC_LWM2M_DEMO
			optional
			prompt "OC LWM2M Demo"
			config OC_LWM2M_DEMO_DTLS
				bool "OC LWM2M DEMO DTLS"
				select OC_LWM2M
				select OC_LWM2M_IMP
				select DTLS
				select SHELL_ENABLE
			config OC_LWM2M_DEMO_NODTLS
				bool "OC LWM2M DEMO NODTLS"
				select OC_LWM2M
				select OC_LWM2M_IMP
				select SHELL_ENABLE
		endchoice
		choice OC_MQTT_DEMO
			optional
			prompt "OC MQTT Demo"
			config OC_MQTT_DEMO_STATIC
				bool "OC MQTT DEMO STATIC"
				select OC_MQTT
				select MQTT
				select CJSON_ENABLE
				select DTLS
				select SHELL_ENABLE
		endchoice
	endmenu
	
	source "targets/Kconfig"
	
	menu "OC Cloud"
		config OC_MQTT
			bool "OC MQTT"
			if OC_MQTT
			choice OC_MQTT_IMP
				optional
				prompt "OC MQTT Integration Process Implement"
				config ATINY_MQTT
					bool "agent tiny mqtt"
					select MQTT
					select CJSON_ENABLE
					select DTLS
				config EC20
					bool "ec20"
					select MQTT
					select AT_ENABLE
					select CJSON_ENABLE
			endchoice
			endif
			
		config OC_LWM2M
			bool "OC LWM2M"
			if OC_LWM2M
			choice OC_LWM2M_IMP
				optional
				prompt "OC LWM2M Integration Process Implement"
				config BOUDICA150
					bool "boudica150"
					select AT_ENABLE
				config ATINY_LWM2M
					bool "agent tiny lwm2m"
					select LWM2M
			endchoice
			endif
	endmenu
	
	menu "Network"
	choice TCPIP_IMP
		optional
		prompt "TCPIP"
		config TCP_LWIP
			bool "lwip"
		config TCP_LINUX
			bool "linux_socket"
		config TCP_MACOS
			bool "macos_socket"
	endchoice
	
	config LWM2M
		bool "LWM2M"
		if LWM2M
		choice LWM2M_IMP
			prompt "Standard LWM2M Implement"
			config LWM2M_IMP_WAKA
				bool "wakaama"
		endchoice
		endif
		
	config MQTT
		bool "MQTT"
		if MQTT
		choice MQTT_IMP
			prompt "Standard MQTT Implement"
			config MQTT_IMP_PAHO
				bool "paho"
		endchoice
		endif
		
	config DTLS
		bool "DTLS"
		if DTLS
		choice DTLS_IMP
			optional
			prompt "DTLS Implement"
			config MBEDTLS
				bool "mbedtls"
				if MBEDTLS
				choice MBEDTLS_MODE
					optional
					prompt "MBEDTLS Mode"
					config CRT
						bool "crt"
					config PSK
						bool "psk"
				endchoice
				endif
		endchoice
		endif
	endmenu
	
	menu "Middleware"
	config DRIVER_ENABLE
		bool "driver"
	config AT_ENABLE
		bool "AT"
		select DRIVER_ENABLE
	config SHELL_ENABLE
		bool "shell"
	config LIBC_ENABLE
		bool "libc"
	config CJSON_ENABLE
		bool "cJSON"
    config STIMER_ENABLE
        bool "stimer"   
	endmenu
	
	choice OS
		optional
		prompt "OS"
		config OS_LiteOS
			bool "liteos"
			select LIBC_ENABLE
		config OS_Linux
			bool "linux"
			select LIBC_ENABLE
		config OS_MacOS
			bool "macos"
			select LIBC_ENABLE
	endchoice
	
	choice CPU_ARCH
		optional
		prompt "CPU Architecture"
		config ARMV7_M
			bool "armv7-m"
		config RISCV32
			bool "riscv32"
	endchoice
	
	config OS_TYPE
		string
		default "liteos" if OS_LiteOS
		default "linux" if OS_Linux
		default "macos" if OS_MacOS
		
	config ARCH_CPU_TYPE
		string
		default "armv7-m" if ARMV7_M
		default "riscv32" if RISCV32
		
	config TCPIP_TYPE
		string
		default "lwip" if TCP_LWIP
		default "linux_socket" if TCP_LINUX
		default "macos_socket" if TCP_MACOS
		default "none"
	
	config DTLS_TYPE
		string
		default "mbedtls" if MBEDTLS
		default "none"
		
	config EMBEDTLS_MODE
		string
		default "crt" if CRT
		default "psk" if PSK
		default "none"
		
	config LWM2M_TYPE
		string
		default "wakaama" if LWM2M_IMP_WAKA
		default "none"
		
	config MQTT_TYPE
		string
		default "paho" if MQTT_IMP_PAHO
		default "none"
		
	config OC_LWM2M_TYPE
		string
		default "soft" if ATINY_LWM2M
		default "boudica150" if BOUDICA150
		default "none"
		
	config OC_MQTT_TYPE
		string
		default "soft" if ATINY_MQTT
		default "ec20" if EC20
		default "none"
		
	config OC_LWM2M_DEMO_TYPE
		string
		default "oc_lwm2m_demo_dtls" if OC_LWM2M_DEMO_DTLS
		default "oc_lwm2m_demo_nodtls" if OC_LWM2M_DEMO_NODTLS
		default "none"
		
	config OC_MQTT_DEMO_TYPE
		string
		default "oc_mqtt_demo_static" if OC_MQTT_DEMO_STATIC
		default "none"
```

## arch/Kconfig
```kconfig
# Copyright (c) Huawei Technologies Co., Ltd. 2019-2020. All rights reserved.

source "arch/arm/Kconfig"
source "arch/arm64/Kconfig"

config LOSCFG_ARCH_FPU_DISABLE
    bool "Disable Floating Pointer Unit"
    default n
    help
      This option will bypass floating procedure in system.

config LOSCFG_ARCH_SECURE_MONITOR_MODE
    bool "Run On Secure Monitor Mode"
    default n
    depends on LOSCFG_ARCH_ARM_AARCH64
    help
      This option will make the system run on EL3.

config LOSCFG_APC_ENABLE
    bool "Enable Access Permission Control"
    default y
    help
      This option will Enable Access Permission Control

config LOSCFG_FPB_ENABLE
    bool "Enable Flash Patch"
    default n
    depends on LOSCFG_ARCH_ARM_CORTEX_M || LOSCFG_ARCH_RISCV_RV32IM
    help
      Answer Y to enable LiteOS to support Flash Patch

config RISCV_FPB_SET_PCO
    bool "Enable patch offset bigger than 1M"
    default y
    depends on LOSCFG_ARCH_RISCV && LOSCFG_FPB_ENABLE
    help
      Enable patch offset bigger than 1M by Set PCO(patch code branch offset) bit

config LOSCFG_LIB_CONFIGURABLE
    bool "Enable Lib Config"
    default n
    help
      Answer Y to enable LiteOS to support lib config
```

## arch/arm/Kconfig
```kconfig
# Copyright (c) Huawei Technologies Co., Ltd. 2019-2020. All rights reserved.

#
# ARM 32-bit(Aarch32) implementations
#
config LOSCFG_ARCH_ARM_AARCH32
    bool
    select LOSCFG_LIB_LIBC
    help
      32-bit ARM architecture implementations.
      It is not limited to ARMv7-A but also ARMv7-R, ARMv7-M and etc.

config LOSCFG_ARCH_ARM_CORTEX_A
    bool
    select LOSCFG_ARCH_ARM_AARCH32

config LOSCFG_ARCH_ARM_CORTEX_R
    bool
    select LOSCFG_ARCH_ARM_AARCH32

config LOSCFG_ARCH_ARM_CORTEX_M
    bool
    select LOSCFG_ARCH_ARM_AARCH32

#
# Architecture Versions
#
config LOSCFG_ARCH_ARM_V7A
    bool
    select LOSCFG_ARCH_ARM_CORTEX_A

config LOSCFG_ARCH_ARM_V8A_AARCH32
    bool
    select LOSCFG_ARCH_ARM_CORTEX_A
    help
      ARMv8-A supported Aarch32 and Aarch64. This option is for ARMv8-A cores running
      at Aarch32 mode.

config LOSCFG_ARCH_ARM_V7R
    bool
    select LOSCFG_ARCH_ARM_CORTEX_R

config LOSCFG_ARCH_ARM_V6M
    bool
    select LOSCFG_ARCH_ARM_CORTEX_M

config LOSCFG_ARCH_ARM_V7M
    bool
    select LOSCFG_ARCH_ARM_CORTEX_M

config LOSCFG_ARCH_ARM_V8R
    bool
    select LOSCFG_ARCH_ARM_CORTEX_R

config LOSCFG_ARCH_ARM_VER
    string
    default "armv6-m" if LOSCFG_ARCH_ARM_V6M
    default "armv7-a" if LOSCFG_ARCH_ARM_V7A
    default "armv7-r" if LOSCFG_ARCH_ARM_V7R
    default "armv7-m" if LOSCFG_ARCH_ARM_V7M
    default "armv8-a" if LOSCFG_ARCH_ARM_V8A_AARCH32
    default "armv8-r" if LOSCFG_ARCH_ARM_V8R

#
# VFP Hardware
#
config LOSCFG_ARCH_FPU_VFP_V3
    bool
    help
      An optional extension to the Arm, Thumb, and ThumbEE instruction sets in the ARMv7-A and ARMv7-R profiles.
      VFPv3U is a variant of VFPv3 that supports the trapping of floating-point exceptions to support code.

config LOSCFG_ARCH_FPU_VFP_V4
    bool
    help
      An optional extension to the Arm, Thumb, and ThumbEE instruction sets in the ARMv7-A and ARMv7-R profiles.
      VFPv4U is a variant of VFPv4 that supports the trapping of floating-point exceptions to support code.
      VFPv4 and VFPv4U add both the Half-precision Extension and the fused multiply-add instructions to the features of VFPv3.

config LOSCFG_ARCH_FPU_VFP_V5
    bool
    help
      An optional extension to the Arm, Thumb, and ThumbEE instruction sets in the ARMv7-A ARMv7-R and ARMv7-M profiles.
      Addition of double-precision operand support for existing data processing instructions in FPv4-SP-D16-M.
      16 double-precision registers. This is the same as for FPv4 and there are no additional registers.
      Software-enable control for single-precision and double-precision support using CPACR.
      Double-precision and single-precision support, when both are implemented, cannot be enabled independently of one another.
      Identical load/store instruction support to FPv4 extensions that already includes support for 64-bit data types.

config LOSCFG_ARCH_FPU_VFP_D16
    bool
    depends on LOSCFG_ARCH_ARM_AARCH32
    help
      VPU implemented with 16 doubleword registers (16 x 64-bit).

config LOSCFG_ARCH_FPU_VFP_D32
    bool
    depends on LOSCFG_ARCH_ARM_AARCH32
    help
      VPU implemented with 32 doubleword registers (32 x 64-bit).

config LOSCFG_ARCH_FPU_VFP_NEON
    bool
    help
      Advanced SIMD extension (NEON) support.

config LOSCFG_ARCH_FPU
    string
    default "vfpv3"       if LOSCFG_ARCH_FPU_VFP_V3 && LOSCFG_ARCH_FPU_VFP_D32
    default "vfpv3-d16"   if LOSCFG_ARCH_FPU_VFP_V3 && LOSCFG_ARCH_FPU_VFP_D16
    default "neon-vfpv4"  if LOSCFG_ARCH_FPU_VFP_V4 && LOSCFG_ARCH_FPU_VFP_D32 && LOSCFG_ARCH_FPU_VFP_NEON
    default "vfpv4"       if LOSCFG_ARCH_FPU_VFP_V4 && LOSCFG_ARCH_FPU_VFP_D32
    default "fpv4-sp-d16" if LOSCFG_ARCH_FPU_VFP_V4 && LOSCFG_ARCH_FPU_VFP_D16 && LOSCFG_ARCH_ARM_V7M
    default "vfpv4-d16"   if LOSCFG_ARCH_FPU_VFP_V4 && LOSCFG_ARCH_FPU_VFP_D16
    default "fpv5-sp-d16" if LOSCFG_ARCH_FPU_VFP_V5 && LOSCFG_ARCH_FPU_VFP_D16

#
# Supported Processor Cores
#
config LOSCFG_ARCH_CORTEX_M0
    bool
    select LOSCFG_ARCH_ARM_V6M
    select LOSCFG_ARCH_ARM_AARCH32

config LOSCFG_ARCH_CORTEX_M3
    bool
    select LOSCFG_ARCH_ARM_V7M
    select LOSCFG_ARCH_ARM_AARCH32
    select LOSCFG_ARCH_FPU_VFP_V3
    select LOSCFG_ARCH_FPU_VFP_D16

config LOSCFG_ARCH_CORTEX_M4
    bool
    select LOSCFG_ARCH_ARM_V7M
    select LOSCFG_ARCH_ARM_AARCH32
    select LOSCFG_ARCH_FPU_VFP_V4
    select LOSCFG_ARCH_FPU_VFP_D16

config LOSCFG_ARCH_CORTEX_M7
    bool
    select LOSCFG_ARCH_ARM_V7M
    select LOSCFG_ARCH_ARM_AARCH32
    select LOSCFG_ARCH_FPU_VFP_V5
    select LOSCFG_ARCH_FPU_VFP_D16

config LOSCFG_ARCH_CORTEX_A7
    bool
    select LOSCFG_ARCH_ARM_V7A
    select LOSCFG_ARCH_FPU_VFP_V4
    select LOSCFG_ARCH_FPU_VFP_D32
    select LOSCFG_ARCH_FPU_VFP_NEON

config LOSCFG_ARCH_CORTEX_A9
    bool
    select LOSCFG_ARCH_ARM_V7A
    select LOSCFG_ARCH_FPU_VFP_V3
    select LOSCFG_ARCH_FPU_VFP_D16

config LOSCFG_ARCH_CORTEX_A53_AARCH32
    bool
    select LOSCFG_ARCH_ARM_V7A
    select LOSCFG_ARCH_FPU_VFP_V4
    select LOSCFG_ARCH_FPU_VFP_D32
    select LOSCFG_ARCH_FPU_VFP_NEON

config LOSCFG_ARCH_CPU
    string
    default "cortex-m0"  if LOSCFG_ARCH_CORTEX_M0
    default "cortex-m3"  if LOSCFG_ARCH_CORTEX_M3
    default "cortex-m4"  if LOSCFG_ARCH_CORTEX_M4
    default "cortex-m7"  if LOSCFG_ARCH_CORTEX_M7
    default "cortex-a7"  if LOSCFG_ARCH_CORTEX_A7
    default "cortex-a9"  if LOSCFG_ARCH_CORTEX_A9
    default "cortex-a53" if LOSCFG_ARCH_CORTEX_A53_AARCH32
```

## arch/arm64/Kconfig
```kconfig
# Copyright (c) Huawei Technologies Co., Ltd. 2019-2020. All rights reserved.

#
# ARM 64-bit(Aarch64) implementations
#
config LOSCFG_ARCH_ARM_AARCH64
    bool
    select LOSCFG_LIB_LIBC
    help
      64-bit ARM architecture implementations.
      AArch64 was introduced in ARMv8-A and is included in subsequent versions of ARMV8-A.

#
# Architecture Versions
#
config LOSCFG_ARCH_ARM_V8A
    bool
    select LOSCFG_ARCH_ARM_AARCH64
    help
      ARMv8-A supported Aarch32 and Aarch64. If this option is chosen, the target platform needs
      to specified whether the core runs in Aarch32 or Aarch64 mode.

config LOSCFG_ARCH_ARM_VER
    string
    default "armv8-a" if LOSCFG_ARCH_ARM_V8A

#
# Supported Processor Cores
#
config LOSCFG_ARCH_CORTEX_A53
    bool
    select LOSCFG_ARCH_ARM_V8A

config LOSCFG_ARCH_CPU
    string
    default "cortex-a53" if LOSCFG_ARCH_CORTEX_A53
```

## compat/cmsis/Kconfig
```kconfig
config  LOSCFG_COMPAT_CMSIS
    bool "Enable Cmsis"
    default y
    select LOSCFG_KERNEL_MEMBOX
    help
      Answer Y to enable LiteOS support cmsis interface.

menu "Cmsis Options"
    depends on LOSCFG_COMPAT_CMSIS

config CMSIS_OS_VER
    int "Cmsis Api Version"
    default 1
    help
      The Cmsis Version Only Support 1 or 2.

endmenu
```

## components/Kconfig
```kconfig
menu "Components"

source "components/connectivity/Kconfig"
source "components/fs/Kconfig"
source "components/gui/Kconfig"
source "components/lib/Kconfig"
source "components/log/Kconfig"
source "components/net/Kconfig"
#source "components/ota/Kconfig"
source "components/security/Kconfig"
source "components/sensorhub/Kconfig"
source "components/ai/Kconfig"

endmenu
```

## components/ai/Kconfig
```kconfig
menu "Ai"

config LOSCFG_COMPONENTS_AI
    bool "Enable Ai"
    default n
    help
      Answer y to enable LiteOS support ai.

endmenu
```

## components/connectivity/Kconfig
```kconfig
menu "Connectivity"

config LOSCFG_COMPONENTS_CONNECTIVITY
    bool "Enable Connectivity"
    default n
    help
      Answer y to enable connectivity.

source "components/connectivity/mqtt/Kconfig"
source "components/connectivity/lwm2m/Kconfig"
source "components/connectivity/agent_tiny/Kconfig"
source "components/connectivity/nb_iot/Kconfig"

endmenu
```

## components/connectivity/agent_tiny/Kconfig
```kconfig
config LOSCFG_COMPONENTS_CONNECTIVITY_ATINY_MQTT
    bool "Enable Agenttiny Mqtt"
    depends on LOSCFG_COMPONENTS_CONNECTIVITY
    select LOSCFG_COMPONENTS_CONNECTIVITY_AGENTTINY
    select LOSCFG_COMPONENTS_CONNECTIVITY_MQTT
    default n
    help
      Answer y to enable agent tiny mqtt.

config LOSCFG_COMPONENTS_CONNECTIVITY_ATINY_LWM2M
    bool "Enable Agenttiny Lwm2m"
    depends on LOSCFG_COMPONENTS_CONNECTIVITY
    select LOSCFG_COMPONENTS_CONNECTIVITY_AGENTTINY
    select LOSCFG_COMPONENTS_CONNECTIVITY_LWM2M
    default n
    help
        Answer y to enable agent tiny lwm2m.

config LOSCFG_COMPONENTS_CONNECTIVITY_AGENTTINY
    bool
```

## components/connectivity/lwm2m/Kconfig
```kconfig
config LOSCFG_COMPONENTS_CONNECTIVITY_LWM2M
    bool "Enable Lwm2m"
    depends on LOSCFG_COMPONENTS_CONNECTIVITY
    default n
    help
        Answer y to enable lwm2m.
```

## components/connectivity/mqtt/Kconfig
```kconfig
config LOSCFG_COMPONENTS_CONNECTIVITY_MQTT
    bool "Enable Mqtt"
    depends on LOSCFG_COMPONENTS_CONNECTIVITY
    default n
    help
        Answer y to enable mqtt.
```

## components/connectivity/nb_iot/Kconfig
```kconfig
config LOSCFG_COMPONENTS_CONNECTIVITY_NB_IOT
    bool "Enable NB IOT"
    depends on LOSCFG_COMPONENTS_NET_AT_BC95
    default n
    help
        Answer y to enable nb iot.
```

## components/fs/Kconfig
```kconfig
menu "FileSystem"

config LOSCFG_COMPONENTS_FS
    bool "Enable FileSystem"
    default n
    select LOSCFG_COMPONENTS_FS_VFS
    help
      Answer y to enable LiteOS support filesystem.

config LOSCFG_COMPONENTS_FS_VFS
    bool "Enable VFS"
    default y
    depends on LOSCFG_COMPONENTS_FS
    help
      Answer y to enable LiteOS support virtual filesystem.

config LOSCFG_COMPONENTS_FS_FATFS
    bool "Enable FATFS"
    default n
    depends on LOSCFG_COMPONENTS_FS_VFS
    help
      Answer y to enable LiteOS support fat filesystem.

config LOSCFG_COMPONENTS_FS_RAMFS
    bool "Enable RAMFS"
    default n
    depends on LOSCFG_COMPONENTS_FS_VFS
    help
      Answer y to enable LiteOS support ram filesystem.

config LOSCFG_COMPONENTS_FS_SPIFFS
    bool "Enable SPIFFS"
    default n
    depends on LOSCFG_COMPONENTS_FS_VFS
    help
      Answer y to enable LiteOS support spi flash filesystem.

endmenu
```

## components/gui/Kconfig
```kconfig
menu "Graphical User Interface"

comment "only support STM32F769IDISCOVERY"

config LOSCFG_COMPONENTS_GUI
    bool "Enable Gui"
    default y
    depends on LOSCFG_PLATFORM_STM32F769IDISCOVERY
    help
      Answer y to enable Graphical User Interface

endmenu
```

## components/lib/Kconfig
```kconfig
menu "Lib"

config LOSCFG_COMPONENTS_LIB
    bool

config LOSCFG_COMPONENTS_LIB_CJSON
    bool "Enable cJSON"
    select LOSCFG_COMPONENTS_LIB
    default n
    help
      Answer y to enable cJSON

endmenu
```
