## components/log/Kconfig
```kconfig
menu "Log"

config LOSCFG_COMPONENTS_LOG
    bool "Enable Log"
    default y
    help
      Answer y to enable log support for agent tiny.

endmenu
```

## components/net/Kconfig
```kconfig
menu "Network"

config LOSCFG_COMPONENTS_NETWORK
    bool "Enable Network"
    default n
    help
      Answer y to enable network support.

config LOSCFG_COMPONENTS_NET_LWIP
    bool "Enable Lwip"
    depends on LOSCFG_COMPONENTS_NETWORK
    default n
    help
      Answer y to enable lwip support.

choice
    prompt "Enable Ipv4 Or Ipv6"
    default LOSCFG_LWIP_IPV4
    depends on LOSCFG_COMPONENTS_NET_LWIP

config LOSCFG_LWIP_IPV4
    bool "Enable Ipv4"

config LOSCFG_LWIP_IPV6
    bool "Enable Ipv6"

endchoice

config LOSCFG_COMPONENTS_NET_SAL
    bool "Enable Sal"
    depends on LOSCFG_COMPONENTS_NETWORK
    default n
    help
      Answer y to enable sal support.

config LOSCFG_COMPONNETS_NET_AT
    bool "Enable AT"
    depends on LOSCFG_COMPONENTS_NETWORK
    default n
    help
        Answer y to enable AT support.

choice
    prompt "Choose AT Device"
    default LOSCFG_COMPONENTS_NET_AT_ESP8266
    depends on LOSCFG_COMPONNETS_NET_AT

    config LOSCFG_COMPONENTS_NET_AT_ESP8266
    bool "Enable esp8266"

    config LOSCFG_COMPONENTS_NET_AT_BC95
    bool "Enable bc95"
    select LOSCFG_COMPONENTS_CONNECTIVITY_NB_IOT

    config LOSCFG_COMPONENTS_NET_AT_SIM900A
    bool "Enable sim900a"

    config LOSCFG_COMPONENTS_NET_AT_BG36
    bool "Enable bg36"

endchoice

config LOSCFG_COMPONNETS_NET_AT_INFO
    bool "Enable AT INFO"
    depends on LOSCFG_COMPONNETS_NET_AT
    default y

config LOSCFG_COMPONNETS_NET_AT_DEBUG
    bool "Enable AT DEBUG"
    depends on LOSCFG_COMPONNETS_NET_AT
    default y

endmenu
```

## components/security/Kconfig
```kconfig
menu "Security"

config LOSCFG_COMPONENTS_SECURITY
    bool "Enable Security"
    default n
    help
      Answer y to enable sucurity component.

config LOSCFG_COMPONENTS_SECURITY_MBEDTLS
    bool "Enable Mbed TLS Component"
    default n
    depends on LOSCFG_COMPONENTS_SECURITY
    help
      Answer y to enable Mbed TLS.

endmenu
```

## components/sensorhub/Kconfig
```kconfig
menu "Sensorhub"

config LOSCFG_COMPONENTS_SENSORHUB
    bool "Enable Sensorhub"
    default n
    help
      Answer y to support Sensor Hub

endmenu
```

## demos/Kconfig
```kconfig
menu "Demos"

source "demos/dtls_server/Kconfig"
source "demos/agenttiny_mqtt/Kconfig"
source "demos/agenttiny_lwm2m/Kconfig"
source "demos/fs/Kconfig"
source "demos/gui/Kconfig"
source "demos/sensorhub/Kconfig"
source "demos/kernel/Kconfig"
source "demos/nbiot_without_atiny/Kconfig"
source "demos/lms/Kconfig"
source "demos/trace/Kconfig"
source "demos/ipv6_client/Kconfig"
source "demos/ai/Kconfig"

endmenu
```

## demos/agenttiny_lwm2m/Kconfig
```kconfig
menu "Agent Tiny Lwm2m Demo"

config LOSCFG_DEMOS_AGENT_TINY_LWM2M
    bool "Enable Agent Tiny Lwm2m Demo"
    default n
    help
      Answer y to enable agent tiny lwm2m demo.

endmenu
```

## demos/agenttiny_mqtt/Kconfig
```kconfig
menu "Agent Tiny Mqtt Demo"

config LOSCFG_DEMOS_AGENT_TINY_MQTT
    bool "Enable Agent Tiny Mqtt Demo"
    default n
    help
      Answer y to enable agent tiny mqtt demo.

config LOSCFG_DTLS_MODE
    string
    default "NO_ENCRYPT"    if LOSCFG_DTLS_NO_ENCRYPT
    default "PSK_ENCRYPT"   if LOSCFG_DTLS_PSK_ENCRYPT
    default "CRET_ENCRYPT"  if LOSCFG_DTLS_CRET_ENCRYPT

choice
    prompt "encryption mode"
    depends on LOSCFG_DEMOS_AGENT_TINY_MQTT
    default LOSCFG_DTLS_NO_ENCRYPT
    help
      support encryption mode:
      NO_ENCRYPT
      PSK_ENCRYPT
      CRET_ENCRYPT

config LOSCFG_DTLS_NO_ENCRYPT
    bool "NO_ENCRYPT"

config LOSCFG_DTLS_PSK_ENCRYPT
    bool "PSK_ENCRYPT"
    select LOSCFG_COMPONENTS_SECURITY
    select LOSCFG_COMPONENTS_SECURITY_MBEDTLS

config LOSCFG_DTLS_CRET_ENCRYPT
    bool "CRET_ENCRYPT"
    select LOSCFG_COMPONENTS_SECURITY
    select LOSCFG_COMPONENTS_SECURITY_MBEDTLS

endchoice

endmenu
```

## demos/ai/Kconfig
```kconfig
menu "Ai Demo"

config LOSCFG_DEMOS_AI
    bool "Enable Ai Demo"
    select LOSCFG_COMPONENTS_AI
    default n
    help
      Answer y to enable ai demo.

config LOSCFG_DEMOS_AI_MNIST
    bool "Mnist Modle"
    depends on LOSCFG_DEMOS_AI
    default n


config LOSCFG_DEMOS_AI_MNIST_QUANT
    bool "Mnist Quant Modle"
    depends on LOSCFG_DEMOS_AI
    default n


config LOSCFG_DEMOS_AI_MOBILENET
    bool "Mobilenet Modle"
    depends on LOSCFG_DEMOS_AI
    default n

config LOSCFG_DEMOS_AI_RESNET
    bool "Resnet Modle"
    depends on LOSCFG_DEMOS_AI
    default n

endmenu
```

## demos/dtls_server/Kconfig
```kconfig
menu "Dtls Server Demo"

config LOSCFG_DEMOS_DTLS_SERVER
    bool "Enable Dtls Server Demo"
    select LOSCFG_COMPONENTS_SECURITY
    select LOSCFG_COMPONENTS_SECURITY_MBEDTLS
    default n
    help
      Answer y to enable dtls server demo.

endmenu
```
